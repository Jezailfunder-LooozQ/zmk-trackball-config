## config/boards/shields/my_split/Kconfig.defconfig
```kconfig
if SHIELD_MY_SPLIT_LEFT

config ZMK_KEYBOARD_NAME
    default "My Split"

config ZMK_SPLIT_ROLE_CENTRAL
    default y

endif

if SHIELD_MY_SPLIT_RIGHT

config ZMK_KEYBOARD_NAME
    default "My Split Right"

endif
```
