## config/west.yml
```yaml
manifest:
  remotes:
    - name: zmkfirmware
      url-base: https://github.com/zmkfirmware

    - name: kaievns
      url-base: https://github.com/kaievns

    - name: jezailfunder
      url-base: https://github.com/Jezailfunder-LooozQ

  projects:
    - name: zmk
      remote: zmkfirmware
      revision: main
      import: app/west.yml

    - name: zmk-trackball-processors
      remote: kaievns
      revision: main

    - name: zmk-angle-processor
      remote: jezailfunder
      revision: vertical-snap

  self:
    path: config
```
